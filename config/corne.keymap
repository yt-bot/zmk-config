/* source key position labels */
#include "zmk-helpers/key-labels/42.h"

/* map Corne's extra keys */
#define X_LT    &kp ESC          // top row, left
#define X_LM    &kp TAB          // middle row, left
#define X_LB    &smart_shft      // bottom row, left
#define X_LB_SV &kp W            // swedish layer, bottom row, left
#define X_LH    SMART_NUM        // thumb row, left

#define X_RT    &kp DELETE       // top row, right
#define X_RM    &none            // middle row, right
#define X_RM_SV_MAC &mac_sv_oe   // macos swedish layer, middle row right
#define X_RM_SV &kp SV_O_UMLAUT  // swedish layer, middle row right
#define X_RM_SV_C &kp SV_A_UMLAUT  // swedish colemak layer, middle row right
#define X_RB    &smart_shft      // bottom row, right
#define X_RH    SK_SHIFT_FN      // thumb row, right

/* activate bluetooth */
#define CONFIG_WIRELESS 1

/* source the main keymap */
#include "base.keymap"
