/* source key position labels */
#include "zmk-helpers/key-labels/42.h"

/* map Corne's extra keys */
#define X_LT    &kp ESC          // top row, left
#define X_LM    &kp TAB          // middle row, left
#define X_LB    &kp &smart_shft  // bottom row, left
#define X_LB_SV &kp W            // swedish layer, bottom row, left
#define X_LH    SK_SHIFT_SYM     // thumb row, left

#define X_RT    &kp DELETE       // top row, right
#define X_RM_SV &kp SV_O_UMLAUT  // swedish layer, middle row right
#define X_RB    &smart_shft      // bottom row, right
#define X_RH    SK_SHIFT_SYM     // thumb row, right

/* activate bluetooth */
#define CONFIG_WIRELESS 1

/* source the main keymap */
#include "base.keymap"

/* use 6-column layout for Corne */
ZMK_APPLY_MATRIX_TRANSFORM(six_column_transform)
