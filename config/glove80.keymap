/* source key position labels */
#include "zmk-helpers/key-labels/glove80.h"

/* map the Glove's extra keys */
#define X_LT  \
                &kp F1    &kp F2 &kp F3 &kp F4 &kp F5                 &kp F6 &kp F7 &kp F8 &kp F9 &kp F10 \
                &kp EQUAL &kp N1 &kp N2 &kp N3 &kp N4 &kp N5   &kp N6 &kp N7 &kp N8 &kp N9 &kp N0 &kp MINUS \
                &kp ESC
#define X_RT    &kp BACKSLASH

#define X_LM    &kp TAB
#define X_RM    &none
#define X_RM_SV &kp SV_O_UMLAUT
#define X_RM_SV_MAC &mac_sv_oe
#define X_LB_SV &kp W            // swedish layer, bottom row, left

#define X_LB    &smart_shft
//#define X_MB    SMART_NUM &none &none       &none &none SK_SHIFT_FN
#define X_RB    &smart_shft

// Gaming layer, thumbs for right hand
#define X_MB    &kp LSHFT &kp LALT &mo SYM_SV       &mo FN &kp RCTRL &kp RSHFT

#define X_LH    &none &none &none &kp LEFT &kp RIGHT
#define X_MH    &kp DELETE &mo SYM
#define X_RH    &kp UP &kp DOWN &none &none &none


/* activate bluetooth */
#define CONFIG_WIRELESS 1

/* source the main keymap */
#include "base.keymap"
