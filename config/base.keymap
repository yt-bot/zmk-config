#include <behaviors.dtsi>
#include <dt-bindings/zmk/keys.h>
#if CONFIG_WIRELESS
    #include <dt-bindings/zmk/bt.h>
    #define _BT_SEL_KEYS_ &bt BT_SEL 0 &bt BT_SEL 1 &bt BT_SEL 2 &bt BT_SEL 3 &bt BT_CLR
    #define _BT_DISC_KEYS_ &bt BT_DISC 0 &bt BT_DISC 1 &bt BT_DISC 2 &bt BT_DISC 3
#else
    #define _BT_SEL_KEYS_ &trans &trans &trans &trans &trans
    #define _BT_DISC_KEYS_ &trans &trans &trans &trans
#endif

#define HOST_OS 1  // Linux

#include "zmk-helpers/helper.h"
#include "zmk-helpers/unicode-chars/swedish.dtsi"
#include "keys_sv.h"
#include "keys_se_finland_sweden.h"

#define SV_MAC 0
#define EN_MAC 1
#define SV 2
#define DEF 3
#define SV_GAME 4
#define SV_COLE 5
#define NAV_LH 6
#define NAV_MAC_LH 7
#define FN 8
#define NUM 9
#define NUM_MAC 10
#define SYM 11
#define SYM_SV 12
#define SYM_SV_MAC 13
#define SYS 14
#define UC 15


#include "combos.dtsi"  // requires layer aliases
#include "extra_keys.h"

#define XXX &none
#define ___ &trans

/* Global settings */

#define QUICK_TAP_MS 175

&sk {  // sticky-key config
    release-after-ms = <900>;  // release after 0.6s
    quick-release;             // no double capitalization when rolling keys
};

&sl {  // sticky-layer config
    ignore-modifiers;          // allow chording sticky mods & layers
};

&lt {  // layer-tap config
    flavor = "balanced";
    tapping-term-ms = <200>;
    quick-tap-ms = <QUICK_TAP_MS>;
};

/* Homerow mods */

#define KEYS_L LT0 LT1 LT2 LT3 LT4 LM0 LM1 LM2 LM3 LM4 LB0 LB1 LB2 LB3 LB4  // left hand
#define KEYS_R RT0 RT1 RT2 RT3 RT4 RM0 RM1 RM2 RM3 RM4 RB0 RB1 RB2 RB3 RB4  // right hand
#define THUMBS LH2 LH1 LH0 RH0 RH1 RH2                                      // thumbs

#define MAKE_HRM(NAME, HOLD, TAP, TRIGGER_POS) \
    ZMK_HOLD_TAP(NAME, \
        flavor = "balanced"; \
        tapping-term-ms = <280>; \
        quick-tap-ms = <QUICK_TAP_MS>; \
        require-prior-idle-ms = <150>; \
        bindings = <HOLD>, <TAP>; \
        hold-trigger-key-positions = <TRIGGER_POS>; \
        hold-trigger-on-release; \
    )
MAKE_HRM(hml, &kp, &kp, KEYS_R THUMBS)  // left-hand HRMs
MAKE_HRM(hmr, &kp, &kp, KEYS_L THUMBS)  // right-hand HRMs

MAKE_HRM(hml_typ, &kp, &kp, KEYS_R THUMBS)  // left-hand HRMs for typing layer
MAKE_HRM(hmr_typ, &kp, &kp, KEYS_L THUMBS)  // right-hand HRMs for typing layer

MAKE_HRM(hml_repeat, &kp, &key_repeat, KEYS_R THUMBS)  // used for HRM-combo
MAKE_HRM(hmr_lpar_lt, &kp, &lpar_lt, KEYS_L THUMBS)    // "    "   "   "
MAKE_HRM(hmr_rpar_gt, &kp, &rpar_gt, KEYS_L THUMBS)    // "    "   "   "

/* Nav cluster */

// long-tap action on hold, short-tap action on all interrupts
#define MT_CORE \
    flavor = "tap-preferred"; \
    tapping-term-ms = <300>; \
    quick-tap-ms = <220>; \
    hold-trigger-key-positions = <0>; \

&mt { MT_CORE };
ZMK_HOLD_TAP(mt_home, bindings = <&masked_home>, <&kp>; MT_CORE)
ZMK_HOLD_TAP(mt_end, bindings = <&masked_end>, <&kp>; MT_CORE)
ZMK_HOLD_TAP(mac_mt_home, bindings = <&mac_masked_home>, <&kp>; MT_CORE)
ZMK_HOLD_TAP(mac_mt_end, bindings = <&mac_masked_end>, <&kp>; MT_CORE)

#define NAV_LEFT  &mt LC(LEFT)   LEFT    // tap: left  | long-tap: beginning of line
#define NAV_RIGHT &mt LC(RIGHT)    RIGHT   // tap: right | long-tap: end       of line
//#define NAV_LEFT  &mt_home 0   LEFT    // tap: left  | long-tap: beginning of line
//#define NAV_RIGHT &mt_end 0    RIGHT   // tap: right | long-tap: end       of line
#define NAV_UP    &mt LC(HOME) UP      // tap: up    | long-tap: beginning of document
#define NAV_DOWN  &mt LC(END)  DOWN    // tap: down  | long-tap: end       of document
#define NAV_BSPC  &mt LC(BSPC) BSPC    // tap: bspc  | long-tap: delete word backward
#define NAV_DEL   &mt LC(DEL)  DEL     // tap: del   | long-tap: delete word forward

#define NAV_UP_MAC    &kp UP      // tap: up    
#define NAV_DOWN_MAC  &kp DOWN    // tap: down 
//#define NAV_UP_MAC    &mt LG(HOME) UP      // tap: up    | long-tap: beginning of document
//#define NAV_DOWN_MAC  &mt LG(END)  DOWN    // tap: down  | long-tap: end of document
#define NAV_LEFT_MAC  &mt LA(LEFT)   LEFT    // tap: left  | long-tap: beginning of word
#define NAV_RIGHT_MAC &mt LA(RIGHT)    RIGHT   // tap: right | long-tap: end of word
//#define NAV_LEFT_MAC  &mac_mt_home 0   LEFT    // tap: left  | long-tap: beginning of line
//#define NAV_RIGHT_MAC &mac_mt_end 0    RIGHT   // tap: right | long-tap: end       of line
#define NAV_BSPC_MAC  &mt LA(BSPC) BSPC    // tap: bspc  | long-tap: delete word backward
#define NAV_DEL_MAC   &mt LA(DEL)  DEL     // tap: del   | long-tap: delete word forward

// mask CTRL when holding left/right to avoid accidental jumps to beginning/end of document
#define MASK_MODS(NAME, MODS, BINDING) \
    ZMK_MOD_MORPH(NAME, \
        bindings = <BINDING>, <BINDING>; \
        mods = <MODS>; \
    )
MASK_MODS(masked_home, (MOD_LCTL), &kp HOME)
MASK_MODS(masked_end,  (MOD_LCTL), &kp END)
MASK_MODS(mac_masked_home, (MOD_LGUI), &kp HOME)
MASK_MODS(mac_masked_end,  (MOD_LGUI), &kp END)

/* Caps-word and num-word */

// tap: sticky-shift | shift + tap/ double-tap: caps-word | hold: shift
ZMK_MOD_MORPH(smart_shft,
    bindings = <&sk LSHFT>, <&caps_word>;
    mods = <(MOD_LSFT)>;
)
&caps_word {  // mods deactivate caps-word, requires PR #1451
    /delete-property/ ignore-modifiers;
};

// tap: sticky shift | double tap: sticky fn layer | hold: fn layer
#define SK_SHIFT_FN &shift_fn FN 0
ZMK_HOLD_TAP(shift_fn,
    flavor = "balanced";
    tapping-term-ms = <200>;
    quick-tap-ms = <QUICK_TAP_MS>;
    bindings = <&mo>, <&fn_dance>;
)
ZMK_TAP_DANCE(fn_dance,
    tapping-term-ms = <200>;
    bindings = <&sk LSHFT>, <&sl FN>;  // reverse this for sticky-fn on single tap
)

// tap: sticky shift | double tap: sticky sym layer | hold: sym layer
#define SK_SHIFT_SYM &shift_sym SYM 0
ZMK_HOLD_TAP(shift_sym,
    flavor = "balanced";
    tapping-term-ms = <200>;
    quick-tap-ms = <QUICK_TAP_MS>;
    bindings = <&mo>, <&sym_dance>;
)
ZMK_TAP_DANCE(sym_dance,
    tapping-term-ms = <200>;
    bindings = <&sk LSHFT>, <&sl SYM>;  // reverse this for sticky-sym on single tap
)

#define SK_SHIFT_SYM_SV &shift_sym SYM_SV 0
ZMK_HOLD_TAP(shift_sym,
    flavor = "balanced";
    tapping-term-ms = <200>;
    quick-tap-ms = <QUICK_TAP_MS>;
    bindings = <&mo>, <&sym_dance>;
)
ZMK_TAP_DANCE(sym_dance,
    tapping-term-ms = <200>;
    bindings = <&sk LSHFT>, <&sl SYM_SV>;  // reverse this for sticky-sym on single tap
)


// tap: num-word | double-tap: sticky num-layer | hold: num-layer
#define SMART_NUM &smart_num NUM 0
ZMK_HOLD_TAP(smart_num,
    flavor = "balanced";
    tapping-term-ms = <200>;
    quick-tap-ms = <QUICK_TAP_MS>;
    bindings = <&mo>, <&num_dance>;
)
ZMK_TAP_DANCE(num_dance,
    tapping-term-ms = <200>;
    bindings = <&num_word>, <&sl NUM>;  // reverse this for sticky-num on single tap
)


#define SMART_NUM_MAC &smart_num_mac NUM_MAC 0
ZMK_HOLD_TAP(smart_num_mac,
    flavor = "balanced";
    tapping-term-ms = <200>;
    quick-tap-ms = <QUICK_TAP_MS>;
    bindings = <&mo>, <&num_dance_mac>;
)
ZMK_TAP_DANCE(num_dance_mac,
    tapping-term-ms = <200>;
    bindings = <&num_word>, <&sl NUM_MAC>;  // reverse this for sticky-num on single tap
)
&num_word {  // num-word, requires PR #1451
    layers = <NUM>;
    continue-list = <BSPC DEL DOT COMMA PLUS MINUS STAR FSLH EQUAL>;
};

/* Custom behaviors */

// Alt+Tab swapper, requires PR #1366
ZMK_TRI_STATE(swap_app,
    bindings = <&kt LALT>, <&kp TAB>, <&kt LALT>;
    ignored-key-positions = <LT2>;
)

ZMK_TRI_STATE(swap_window,
    bindings = <&kt LCTRL>, <&kp TAB>, <&kt LCTRL>;
    ignored-key-positions = <LT2>;
)

// Alt+Tab swapper for mac, requires PR #1366
ZMK_TRI_STATE(swap_app_mac,
    bindings = <&kt LGUI>, <&kp TAB>, <&kt LGUI>;
    ignored-key-positions = <LT2>;
)

ZMK_TRI_STATE(swap_window_mac,
    bindings = <&kt LCTRL>, <&kp TAB>, <&kt LCTRL>;
    ignored-key-positions = <LT2>;
)

// Sticky layer + sticky shift (workaround for issue #1421)
ZMK_STICKY_KEY(sls,
    release-after-ms = <1000>;
    bindings = <&uc_shift>;
    ignore-modifiers;
)
ZMK_MACRO(uc_shift,
    wait-ms = <0>;
    tap-ms = <1>;
    bindings = <&macro_press &mo UC &kp LSHFT>
             , <&macro_pause_for_release>
             , <&macro_release &mo UC &kp LSHFT>;
)

// reuse basic mod-morph scheme
#define SIMPLE_MORPH(NAME, MOD, BINDING1, BINDING2) \
    ZMK_MOD_MORPH(NAME, \
        mods = <(MOD_L ## MOD|MOD_R ## MOD)>; \
        bindings = <BINDING1>, <BINDING2>; \
    )

// The following have been replaced with &mt keys.
// tap: comma | shift + tap: semicolon | ctrl + shift + tap: <
// SIMPLE_MORPH(comma_morph, SFT, &kp COMMA, &comma_inner_morph)
// SIMPLE_MORPH(comma_inner_morph, CTL, &kp SEMICOLON, &kp LESS_THAN)

// tap: dot | shift + tap: colon | ctrl + shift + tap: >
// SIMPLE_MORPH(dot_morph, SFT, &kp DOT, &dot_inner_morph)
// SIMPLE_MORPH(dot_inner_morph, CTL, &kp COLON, &kp GREATER_THAN)

// tap: qmark | shift + tap: excl
// SIMPLE_MORPH(qexcl, SFT, &kp QMARK, &kp EXCL)

// tap: left/right parenthesis | shft + tap: less-than/greater-than
SIMPLE_MORPH(lpar_lt, SFT, &kp LPAR, &kp LT)
SIMPLE_MORPH(rpar_gt, SFT, &kp RPAR, &kp GT)

// tap: key | hold: activate layer
ZMK_HOLD_TAP(lt_layer_key,
    flavor = "tap-preferred";
    tapping-term-ms = <220>;
    quick-tap-ms = <250>;
    bindings = <&mo>, <&kp>;
)

// tap: key 1 | hold: key 2
ZMK_HOLD_TAP(td_keys,
    flavor = "tap-preferred";
    tapping-term-ms = <190>;
    quick-tap-ms = <250>;
    bindings = <&kp>, <&kp>;
)

// Tap-dance and layer tap: one tap outputs a key press, two taps switches to layer, tap and hold enables the layer temporarily.
ZMK_TAP_DANCE(tdl_sym_v,
    tapping-term-ms = <200>;
    bindings = <&lt SYM V>, <&to SYM>;
)

// tap: space | shift + tap: dot -> space -> sticky shift | hold: activate layer
ZMK_HOLD_TAP(lt_spc,
    flavor = "tap-preferred";
    tapping-term-ms = <200>;
    quick-tap-ms = <QUICK_TAP_MS>;
    bindings = <&mo>, <&spc_morph>;
)
SIMPLE_MORPH(spc_morph, SFT, &kp SPACE, &dot_spc)
ZMK_MACRO(dot_spc,
    wait-ms = <0>;
    tap-ms = <5>;
    bindings = <&kp DOT &kp SPACE &sk LSHFT>;
)

// tap: backspace | lshft + tap: delete | rshft + tap: shift-delete
ZMK_MOD_MORPH(bs_del,
    bindings = <&kp BSPC>, <&kp DEL>;
    mods = <(MOD_LSFT|MOD_RSFT)>;
    keep-mods = <MOD_RSFT>;
)

// tap: copy | double-tap: cut
ZMK_TAP_DANCE(copy_cut,
    tapping-term-ms = <200>;
    bindings = <&kp LC(C)>, <&kp LC(X)>;
)

// tap: copy | double-tap: cut
ZMK_TAP_DANCE(copy_cut_mac,
    tapping-term-ms = <200>;
    bindings = <&kp LG(C)>, <&kp LG(X)>;
)

// Tap-dance and layer tap: one tap outputs a key press, two taps switches to layer, tap and hold enables the layer temporarily.
ZMK_TAP_DANCE(tdl_sym_bspc,
    tapping-term-ms = <200>;
    bindings = <&lt SYM BACKSPACE>, <&to SYM>;
)

ZMK_MACRO(end_quote_comma,
    bindings = <&kp COMMA &kp DQT &kp SPACE>;
)

ZMK_MACRO(end_quote_dot,
    bindings = <&kp DOT &kp DQT &kp SPACE>;
)

// Windows sleep key
ZMK_MACRO(win_sleep,
    wait-ms = <500>;
    tap-ms = <50>;
    bindings = <&kp LG(X) &kp U &kp S>;
)

// misc aliases
#define CANCEL      &kp K_CANCEL                // cancel caps-word and num-word
#define DSK_PREV    &hmr LCTRL LG(LC(LEFT))     // previous desktop
#define DSK_NEXT    &hmr LALT LG(LC(RIGHT))     // next     desktop
#define PIN_WIN     &kp LG(LC(LS(Q)))           // pin window across desktops
#define PIN_APP     &kp LG(LC(LS(A)))           // pin application across desktops
#define DSK_MGR     &kp LA(GRAVE)               // desktop manager
#define VOL_DOWN    &hmr RSHFT C_VOL_DN

#define LIN_LOCK  &kp LG(L)
#define MAC_LOCK  &kp LC(LG(Q))
#define MAC_NEXT_DESK &kp LC(RIGHT)
#define MAC_PREV_DESK &kp LC(LEFT)

// Separate Mac SV symbol layer keys
// Note: mac hid codes for some symbols aren't working when using FI/SE layout, replace with key presses.
// less than/greater than don't work when the keyboard layout is set to FI/SE, they are always replaced with section. https://www.reddit.com/r/ErgoDoxEZ/comments/n0rk9d/get_greater_than_sign_on_macos_german_keyboard/
#define MAC_LBRC &kp LA(LS(N8)) // {
#define MAC_RBRC &kp LA(LS(N9)) // }
#define MAC_BSLH &kp LA(LS(N7)) // 

//#define MAC_LT   &kp LA(LS(Y)) // < 
//#define MAC_GT   &kp LA(LS(X)) // >

/* Keymap */

// Linux unicodes
ZMK_UNICODE_PAIR(lin_sv_ae,   N0, N0,  E, N4,   N0, N0,  C, N4)
ZMK_UNICODE_PAIR(lin_sv_ao,   N0, N0,  E, N5,   N0, N0,  C, N5)
ZMK_UNICODE_PAIR(lin_sv_oe,   N0, N0,  F, N6,   N0, N0,  D, N6)
ZMK_UNICODE_SINGLE(lin_euro_sign, N2, N0, A, C)  // €

// MacOS unicodes
#undef OS_UNICODE_LEAD
#undef OS_UNICODE_TRAIL
#define OS_UNICODE_LEAD &macro_press &kp LALT  // <- MacOS compose sequence (must be activated in system preferences)
#define OS_UNICODE_TRAIL &macro_release &kp LALT  // <- Releasing Left-Alt terminates unicode input on MacOS
ZMK_UNICODE_PAIR(mac_sv_ae,   N0, N0,  E, N4,   N0, N0,  C, N4)
ZMK_UNICODE_PAIR(mac_sv_ao,   N0, N0,  E, N5,   N0, N0,  C, N5)
ZMK_UNICODE_PAIR(mac_sv_oe,   N0, N0,  F, N6,   N0, N0,  D, N6)
ZMK_UNICODE_SINGLE(mac_euro_sign, N2, N0, A, C)  // €

// MacOS Swedish layout. Set keyboard layout to Unicode Hex Input (U+) on the host.
// See corne.keymap and glove80.keymap for key placements, including W.
ZMK_LAYER(mac,
//╭──────╮ ╭─────────────┬─────────────┬─────────────┬─────────────┬─────────────╮ ╭──────╮ ╭─────────────┬─────────────┬─────────────┬─────────────┬─────────────╮ ╭──────╮
    X_LT     &kp Q         &mac_sv_ae    &kp E         &kp R         &kp T           X_MT     &kp Y         &kp U         &kp I         &kp O         &kp SQT         X_RT
//├──────┤ ├─────────────┼─────────────┼─────────────┼─────────────┼─────────────┤ ├──────┤ ├─────────────┼─────────────┼─────────────┼─────────────┼─────────────┤ ├──────┤
    X_LM     &hml LCTRL A  &hml LALT S   &hml LSHFT D  &hml LGUI F   &kp G           X_MM     &kp H         &hmr LGUI J  &hmr RSHFT K  &hmr LALT L   &hmr LCTRL P    X_RM_SV_MAC 
//├──────┤ ├─────────────┼─────────────┼─────────────┼─────────────┼─────────────┤ ├──────┤ ├─────────────┼─────────────┼─────────────┼─────────────┼─────────────┤ ├──────┤
    X_LB_SV  &kp Z         &kp X         &kp C         &kp V         &kp B           X_MB     &kp N         &kp M         &kp COMMA     &kp DOT       &mt BSLH FSLH   X_RB
//├──────┤ ╰─────────────┼─────────────┴─────────────┼─────────────┼─────────────┤ ├──────┤ ├─────────────┼─────────────┼─────────────┴─────────────|─────────────╯ ├──────┤
    X_LH                                                NAV_BSPC     SK_SHIFT_SYM    X_MH     &lt SYM RET &lt_spc NAV_MAC_LH 0                                        X_RH
//╰──────╯                              ╰────────────┴─────────────┴─────────────╯ ╰──────╯ ╰─────────────┴─────────────┴─────────────╯                             ╰──────╯
)

// MacOS US ANSI layout.
ZMK_LAYER(mac_en,
//╭──────╮ ╭─────────────┬─────────────┬─────────────┬─────────────┬─────────────╮ ╭──────╮ ╭─────────────┬─────────────┬─────────────┬─────────────┬─────────────╮ ╭──────╮
    X_LT     &kp Q         &kp W         &kp E         &kp R         &kp T           X_MT     &kp Y         &kp U         &kp I         &kp O         &kp SQT         X_RT
//├──────┤ ├─────────────┼─────────────┼─────────────┼─────────────┼─────────────┤ ├──────┤ ├─────────────┼─────────────┼─────────────┼─────────────┼─────────────┤ ├──────┤
    X_LM     &hml LCTRL A  &hml LALT S   &hml LSHFT D  &hml LGUI F   &kp G           X_MM     &kp H         &hmr RGUI J  &hmr RSHFT K   &hmr LALT L   &hmr RCTRL P    X_RM
//├──────┤ ├─────────────┼─────────────┼─────────────┼─────────────┼─────────────┤ ├──────┤ ├─────────────┼─────────────┼─────────────┼─────────────┼─────────────┤ ├──────┤
    X_LB     &kp Z         &kp X         &kp C         &kp V         &kp B           X_MB     &kp N         &kp M        &kp COMMA      &kp DOT       &mt BSLH FSLH   X_RB
//├──────┤ ╰─────────────┼─────────────┴─────────────┼─────────────┼─────────────┤ ├──────┤ ├─────────────┼─────────────┼─────────────┴─────────────|─────────────╯ ├──────┤
    X_LH                                               NAV_BSPC     SK_SHIFT_SYM     X_MH     &lt SYM RET &lt_spc NAV_MAC_LH 0                                        X_RH
//╰──────╯                              ╰────────────┴─────────────┴─────────────╯ ╰──────╯ ╰─────────────┴─────────────┴─────────────╯                             ╰──────╯
)

// Linux Swedish layout. Set keyboard layout to sv/fi on the host.
// See corne.keymap and glove80.keymap for key placements, including W.
ZMK_LAYER(linux,
//╭──────╮ ╭─────────────┬─────────────┬─────────────┬─────────────┬─────────────╮ ╭──────╮ ╭─────────────┬─────────────┬─────────────┬─────────────┬─────────────╮ ╭──────╮
    X_LT     &kp Q       &kp SV_A_UMLAUT &kp E         &kp R         &kp T           X_MT     &kp Y         &kp U         &kp I         &kp O       &mt SV_A_RING SV_SQT X_RT
//├──────┤ ├─────────────┼─────────────┼─────────────┼─────────────┼─────────────┤ ├──────┤ ├─────────────┼─────────────┼─────────────┼─────────────┼─────────────┤ ├──────┤
    X_LM     &hml LGUI A   &hml LALT S   &hml LSHFT D  &hml LCTRL F  &kp G           X_MM     &kp H         &hmr LCTRL J  &hmr RSHFT K  &hmr LALT L   &hmr LGUI P     X_RM_SV 
//├──────┤ ├─────────────┼─────────────┼─────────────┼─────────────┼─────────────┤ ├──────┤ ├─────────────┼─────────────┼─────────────┼─────────────┼─────────────┤ ├──────┤
    X_LB_SV  &kp Z         &kp X         &kp C         &kp V         &kp B           X_MB     &kp N         &kp M         &kp COMMA     &kp DOT     &mt SV_BSLH SV_FSLH X_RB
//├──────┤ ╰─────────────┼─────────────┴─────────────┼─────────────┼─────────────┤ ├──────┤ ├─────────────┼─────────────┼─────────────┴─────────────|─────────────╯ ├──────┤
    X_LH                                                NAV_BSPC     SK_SHIFT_SYM_SV X_MH     &lt SYM_SV RET &lt_spc NAV_LH 0                                         X_RH
//╰──────╯                              ╰────────────┴─────────────┴─────────────╯ ╰──────╯ ╰─────────────┴─────────────┴─────────────╯                             ╰──────╯
)

// Linux US ANSI layout.
ZMK_LAYER(linux_en,
//╭──────╮ ╭─────────────┬─────────────┬─────────────┬─────────────┬─────────────╮ ╭──────╮ ╭─────────────┬─────────────┬─────────────┬─────────────┬─────────────╮ ╭──────╮
    X_LT     &kp Q         &kp W         &kp E         &kp R         &kp T           X_MT     &kp Y         &kp U         &kp I         &kp O         &kp SQT         X_RT
//├──────┤ ├─────────────┼─────────────┼─────────────┼─────────────┼─────────────┤ ├──────┤ ├─────────────┼─────────────┼─────────────┼─────────────┼─────────────┤ ├──────┤
    X_LM     &hml LGUI A   &hml LALT S   &hml LSHFT D  &hml LCTRL F  &kp G           X_MM     &kp H         &hmr LCTRL J  &hmr RSHFT K  &hmr LALT L   &hmr LGUI P     X_RM
//├──────┤ ├─────────────┼─────────────┼─────────────┼─────────────┼─────────────┤ ├──────┤ ├─────────────┼─────────────┼─────────────┼─────────────┼─────────────┤ ├──────┤
    X_LB     &kp Z         &kp X         &kp C         &kp V         &kp B           X_MB     &kp N         &kp M         &kp COMMA     &kp DOT       &mt BSLH FSLH   X_RB
//├──────┤ ╰─────────────┼─────────────┴─────────────┼─────────────┼─────────────┤ ├──────┤ ├─────────────┼─────────────┼─────────────┴─────────────|─────────────╯ ├──────┤
    X_LH                                               NAV_BSPC     SK_SHIFT_SYM     X_MH     &lt SYM RET   &lt_spc NAV_LH 0                                          X_RH
//╰──────╯                              ╰────────────┴─────────────┴─────────────╯ ╰──────╯ ╰─────────────┴─────────────┴─────────────╯                             ╰──────╯
)

// Linux left handed gaming layout (asdw). Set keyboard layout to sv/fi on the host.
ZMK_LAYER(linux_gaming,
//╭──────╮ ╭─────────────┬─────────────┬─────────────┬─────────────┬─────────────╮ ╭──────╮ ╭─────────────┬─────────────┬─────────────┬─────────────┬─────────────╮ ╭──────╮
    X_LT     &kp Q         &kp W         &kp E         &kp R         &kp T           X_MT     &kp TAB       &kp Q         &kp W         &kp E         &kp R           X_RT
//├──────┤ ├─────────────┼─────────────┼─────────────┼─────────────┼─────────────┤ ├──────┤ ├─────────────┼─────────────┼─────────────┼─────────────┼─────────────┤ ├──────┤
    X_LM     &hml LGUI A   &hml LALT S   &hml LSHFT D  &hml LCTRL F  &kp G           X_MM     &kp CAPS      &kp A         &kp S         &kp D         &kp F           X_RM 
//├──────┤ ├─────────────┼─────────────┼─────────────┼─────────────┼─────────────┤ ├──────┤ ├─────────────┼─────────────┼─────────────┼─────────────┼─────────────┤ ├──────┤
    X_LB_SV  &kp Z         &kp X         &kp C         &kp V         &kp B           X_MB     &kp RSHFT     &kp Z         &kp X         &kp C         &kp V           X_RB
//├──────┤ ╰─────────────┼─────────────┴─────────────┼─────────────┼─────────────┤ ├──────┤ ├─────────────┼─────────────┼─────────────┴─────────────|─────────────╯ ├──────┤
    X_LH                                                NAV_BSPC     SK_SHIFT_SYM_SV X_MH     &kp RET       &kp SV_SPACE                                              X_RH
//╰──────╯                              ╰────────────┴─────────────┴─────────────╯ ╰──────╯ ╰─────────────┴─────────────┴─────────────╯                             ╰──────╯
)


// Linux colemakish Swedish layout. Set keyboard layout to sv/fi on the host.
// See corne.keymap and glove80.keymap for key placements, including W.
ZMK_LAYER(linux_cole,
//╭──────╮ ╭─────────────┬─────────────┬─────────────┬─────────────┬─────────────╮ ╭──────╮ ╭─────────────┬─────────────┬─────────────┬─────────────┬─────────────╮ ╭──────╮
    X_LT     &kp Q         &kp W         &kp F         &kp P         &kp B           X_MT     &kp J         &kp L         &kp U         &kp Y       &mt SV_O_UMLAUT SV_SQT X_RT
//├──────┤ ├─────────────┼─────────────┼─────────────┼─────────────┼─────────────┤ ├──────┤ ├─────────────┼─────────────┼─────────────┼─────────────┼─────────────┤ ├──────┤
    X_LM     &hml LGUI A   &hml LALT R   &hml LSHFT S  &hml LCTRL T  &kp G           X_MM     &kp M         &hmr LCTRL N  &hmr RSHFT E  &hmr LALT I   &hmr LGUI O    X_RM_SV_C 
//├──────┤ ├─────────────┼─────────────┼─────────────┼─────────────┼─────────────┤ ├──────┤ ├─────────────┼─────────────┼─────────────┼─────────────┼─────────────┤ ├──────┤
    X_LB_SV  &kp Z         &kp X         &kp C         &kp D         &kp V           X_MB     &kp K         &kp H         &kp COMMA     &kp DOT     &mt SV_BSLH SV_FSLH X_RB
//├──────┤ ╰─────────────┼─────────────┴─────────────┼─────────────┼─────────────┤ ├──────┤ ├─────────────┼─────────────┼─────────────┴─────────────|─────────────╯ ├──────┤
    X_LH                                                NAV_BSPC     SK_SHIFT_SYM_SV X_MH     &lt SYM_SV RET &lt_spc NAV_LH 0                                         X_RH
//╰──────╯                              ╰────────────┴─────────────┴─────────────╯ ╰──────╯ ╰─────────────┴─────────────┴─────────────╯                             ╰──────╯
)

ZMK_LAYER(nav_left_hand,
//╭──────╮ ╭─────────────┬─────────────┬─────────────┬─────────────┬─────────────╮ ╭──────╮ ╭─────────────┬─────────────┬─────────────┬─────────────┬─────────────╮ ╭──────╮
    X_LT     ___           NAV_DEL       NAV_UP        NAV_BSPC      &kp PG_UP       X_MT     ___           &swap_app     &swap_window  ___           ___             X_RT
//├──────┤ ├─────────────┼─────────────┼─────────────┼─────────────┼─────────────┤ ├──────┤ ├─────────────┼─────────────┼─────────────┼─────────────┼─────────────┤ ├──────┤
    X_LM     &kp RET       NAV_LEFT      NAV_DOWN      NAV_RIGHT     &kp PG_DN       X_MM     ___           &sk RCTRL     &sk LSHFT     &sk RALT      &sk RGUI        X_RM
//├──────┤ ├─────────────┼─────────────┼─────────────┼─────────────┼─────────────┤ ├──────┤ ├─────────────┼─────────────┼─────────────┼─────────────┼─────────────┤ ├──────┤
    X_LB     ___           ___           ___           NAV_BSPC           ___        X_MB     ___           ___           ___           ___           ___             X_RB
//├──────┤ ╰─────────────┼─────────────┴─────────────┼─────────────┼─────────────┤ ├──────┤ ├─────────────┼─────────────┼─────────────┴───────────────────────────╯ ├──────┤
    X_LH                                               ___           ___             X_MH     &to SV        &to DEF                                                   X_RH
//╰──────╯                                           ╰─────────────┴─────────────╯ ╰──────╯ ╰─────────────┴─────────────╯                                           ╰──────╯
)

ZMK_LAYER(nav_left_hand_mac,
//╭──────╮ ╭─────────────┬─────────────┬─────────────┬─────────────┬─────────────╮ ╭──────╮ ╭─────────────┬─────────────┬─────────────┬─────────────┬─────────────╮ ╭──────╮
    X_LT     ___           NAV_DEL_MAC   NAV_UP_MAC    NAV_BSPC_MAC  &kp PG_UP       X_MT     ___           &swap_app_mac &swap_window_mac  ___       ___             X_RT
//├──────┤ ├─────────────┼─────────────┼─────────────┼─────────────┼─────────────┤ ├──────┤ ├─────────────┼─────────────┼─────────────┼─────────────┼─────────────┤ ├──────┤
    X_LM     &kp RET       NAV_LEFT_MAC  NAV_DOWN_MAC  NAV_RIGHT_MAC &kp PG_DN       X_MM     ___           &sk RCTRL     &sk LSHFT     &sk RALT      &sk RGUI        X_RM
//├──────┤ ├─────────────┼─────────────┼─────────────┼─────────────┼─────────────┤ ├──────┤ ├─────────────┼─────────────┼─────────────┼─────────────┼─────────────┤ ├──────┤
    X_LB     ___           MAC_PREV_DESK MAC_NEXT_DESK NAV_BSPC_MAC  &kp ESC         X_MB     ___           ___           ___           ___           ___             X_RB
//├──────┤ ╰─────────────┼─────────────┴─────────────┼─────────────┼─────────────┤ ├──────┤ ├─────────────┼─────────────┼─────────────┴───────────────────────────╯ ├──────┤
    X_LH                                               CANCEL        ___             X_MH     &to SV_MAC    &to EN_MAC                                                X_RH
//╰──────╯                                           ╰─────────────┴─────────────╯ ╰──────╯ ╰─────────────┴─────────────╯                                           ╰──────╯
)

ZMK_LAYER(fn,
//╭──────╮ ╭─────────────┬─────────────┬─────────────┬─────────────┬─────────────╮ ╭──────╮ ╭─────────────┬─────────────┬─────────────┬─────────────┬─────────────╮ ╭──────╮
    X_LT     &kp C_PP      &kp C_PREV    &kp C_VOL_UP  &kp C_NEXT    ___             X_MT     ___           &kp F7        &kp F8        &kp F9        &kp F12         X_RT
//├──────┤ ├─────────────┼─────────────┼─────────────┼─────────────┼─────────────┤ ├──────┤ ├─────────────┼─────────────┼─────────────┼─────────────┼─────────────┤ ├──────┤
    X_LM     &kp C_MUTE    &kp ESC       VOL_DOWN      DSK_NEXT      ___             X_MM     ___           &hml RCTRL F4 &hml RSHIFT F5 &hml RALT F6 &hml RGUI F11   X_RM
//├──────┤ ├─────────────┼─────────────┼─────────────┼─────────────┼─────────────┤ ├──────┤ ├─────────────┼─────────────┼─────────────┼─────────────┼─────────────┤ ├──────┤
    X_LB     &to SV_MAC    &to EN_MAC    &to DEF       &to SV        &to SV_COLE     X_MB     &to SV_GAME   &kp F1        &kp F2        &kp F3        &kp F10         X_RB
//├──────┤ ╰─────────────┼─────────────┴─────────────┼─────────────┼─────────────┤ ├──────┤ ├─────────────┼─────────────┼─────────────┴───────────────────────────╯ ├──────┤
    X_LH                                               ___           ___             X_MH     ___           ___                                                       X_RH
//╰──────╯                                           ╰─────────────┴─────────────╯ ╰──────╯ ╰─────────────┴─────────────╯                                           ╰──────╯
)

ZMK_LAYER(num,
//╭──────╮ ╭─────────────┬─────────────┬─────────────┬─────────────┬─────────────╮ ╭──────╮ ╭─────────────┬─────────────┬─────────────┬─────────────┬─────────────╮ ╭──────╮
    X_LT     XXX           XXX           &kp LPAR      &kp RPAR      XXX             X_MT     XXX           &kp N7        &kp N8        &kp N9        &kp N0          X_RT
//├──────┤ ├─────────────┼─────────────┼─────────────┼─────────────┼─────────────┤ ├──────┤ ├─────────────┼─────────────┼─────────────┼─────────────┼─────────────┤ ├──────┤
    X_LM     &sk LGUI      &sk LALT      &sk LSHFT     &sk LCTRL     XXX             X_MM     XXX           &kp N4        &kp N5        &kp N6        &kp DOT         X_RM
//├──────┤ ├─────────────┼─────────────┼─────────────┼─────────────┼─────────────┤ ├──────┤ ├─────────────┼─────────────┼─────────────┼─────────────┼─────────────┤ ├──────┤
    X_LB     &kp FSLH      &kp STAR      &kp PLUS      &kp MINUS     &kp EQUAL       X_MB     &kp N0        &kp N1        &kp N2        &kp N3        &kp COMMA       X_RB
//├──────┤ ╰─────────────┼─────────────┴─────────────┼─────────────┼─────────────┤ ├──────┤ ├─────────────┼─────────────┼─────────────┴───────────────────────────╯ ├──────┤
    X_LH                                               ___           ___             X_MH     ___           CANCEL                                                    X_RH
//╰──────╯                                           ╰─────────────┴─────────────╯ ╰──────╯ ╰─────────────┴─────────────╯                                           ╰──────╯
)

ZMK_LAYER(num_mac,
//╭──────╮ ╭─────────────┬─────────────┬─────────────┬─────────────┬─────────────╮ ╭──────╮ ╭─────────────┬─────────────┬─────────────┬─────────────┬─────────────╮ ╭──────╮
    X_LT     XXX           XXX           &kp LPAR      &kp RPAR      XXX             X_MT     XXX           &kp N7        &kp N8        &kp N9        &kp N0          X_RT
//├──────┤ ├─────────────┼─────────────┼─────────────┼─────────────┼─────────────┤ ├──────┤ ├─────────────┼─────────────┼─────────────┼─────────────┼─────────────┤ ├──────┤
    X_LM     &sk LCTRL     &sk LALT      &sk LSHFT     &sk LGUI      XXX             X_MM     XXX           &kp N4        &kp N5        &kp N6        &kp DOT         X_RM
//├──────┤ ├─────────────┼─────────────┼─────────────┼─────────────┼─────────────┤ ├──────┤ ├─────────────┼─────────────┼─────────────┼─────────────┼─────────────┤ ├──────┤
    X_LB     &kp FSLH      &kp STAR      &kp PLUS      &kp MINUS     &kp EQUAL       X_MB     &kp N0        &kp N1        &kp N2        &kp N3        &kp COMMA       X_RB
//├──────┤ ╰─────────────┼─────────────┴─────────────┼─────────────┼─────────────┤ ├──────┤ ├─────────────┼─────────────┼─────────────┴───────────────────────────╯ ├──────┤
    X_LH                                               ___           ___             X_MH     ___           CANCEL                                                    X_RH
//╰──────╯                                           ╰─────────────┴─────────────╯ ╰──────╯ ╰─────────────┴─────────────╯                                           ╰──────╯
)

ZMK_LAYER(sym,
//╭──────╮ ╭─────────────┬─────────────┬─────────────┬─────────────┬─────────────╮ ╭──────╮ ╭─────────────┬─────────────┬─────────────┬─────────────┬─────────────╮ ╭──────╮
    X_LT     &kp PRCNT     &kp AT        &kp HASH      &kp DLLR      &kp LT          X_MT     &kp GT        &kp LBRC      &kp STAR      &kp RBRC      &kp CARET       X_RT
//├──────┤ ├─────────────┼─────────────┼─────────────┼─────────────┼─────────────┤ ├──────┤ ├─────────────┼─────────────┼─────────────┼─────────────┼─────────────┤ ├──────┤
    X_LM     &kp SQT       &kp MINUS     &kp DQT       &kp EQUAL     &kp QMARK       X_MM     &kp EXCL      &kp LPAR      &kp FSLH      &kp RPAR      &kp COLON       X_RM
//├──────┤ ├─────────────┼─────────────┼─────────────┼─────────────┼─────────────┤ ├──────┤ ├─────────────┼─────────────┼─────────────┼─────────────┼─────────────┤ ├──────┤
    X_LB     &kp BSLH      &kp UNDER     &kp TILDE     &kp GRAVE     &kp PIPE        X_MB     &kp AMPS      &kp LBKT      &kp PLUS      &kp RBKT      &kp SEMICOLON   X_RB
//├──────┤ ╰─────────────┼─────────────┴─────────────┼─────────────┼─────────────┤ ├──────┤ ├─────────────┼─────────────┼─────────────┴─────────────┴─────────────╯ ├──────┤
    X_LH                                               &to DEF      &lin_euro_sign    X_MH    &mac_euro_sign &to SV_MAC                                               X_RH
//╰──────╯                                           ╰─────────────┴─────────────╯ ╰──────╯ ╰─────────────┴─────────────╯                                           ╰──────╯
)

ZMK_LAYER(sym_sv,
//╭──────╮ ╭─────────────┬─────────────┬─────────────┬─────────────┬─────────────╮ ╭──────╮ ╭─────────────┬─────────────┬─────────────┬─────────────┬─────────────╮ ╭──────╮
    X_LT     &kp SV_PRCNT  &kp SV_AT     &kp SV_HASH   &kp SV_DLLR   &kp SV_LT       X_MT     &kp SV_GT     &kp SV_LBRC   &kp SV_STAR   &kp SV_RBRC  &kp SV_CARET     X_RT
//├──────┤ ├─────────────┼─────────────┼─────────────┼─────────────┼─────────────┤ ├──────┤ ├─────────────┼─────────────┼─────────────┼─────────────┼─────────────┤ ├──────┤
    X_LM     &kp SV_SQT    &kp SV_MINUS  &kp SV_DQT    &kp SV_EQUAL  &kp SV_QMARK    X_MM     &kp EXCL      &kp SV_LPAR   &kp SV_FSLH   &kp SV_RPAR   &kp SV_COLON    X_RM
//├──────┤ ├─────────────┼─────────────┼─────────────┼─────────────┼─────────────┤ ├──────┤ ├─────────────┼─────────────┼─────────────┼─────────────┼─────────────┤ ├──────┤
    X_LB     &kp SV_BSLH   &kp SV_UNDER  &kp SV_TILDE  &kp SV_GRAVE  &kp SV_PIPE     X_MB     &kp SV_AMPS   &kp SV_LBKT   &kp SV_PLUS   &kp SV_RBKT   &kp SV_SEMICOLON X_RB
//├──────┤ ╰─────────────┼─────────────┴─────────────┼─────────────┼─────────────┤ ├──────┤ ├─────────────┼─────────────┼─────────────┴─────────────┴─────────────╯ ├──────┤
    X_LH                                               &to SV        &kp SV_EURO     X_MH    &mac_euro_sign &to SV_MAC                                                X_RH
//╰──────╯                                           ╰─────────────┴─────────────╯ ╰──────╯ ╰─────────────┴─────────────╯                                           ╰──────╯
)

ZMK_LAYER(sym_sv_mac,
//╭──────╮ ╭─────────────┬─────────────┬─────────────┬─────────────┬─────────────╮ ╭──────╮ ╭─────────────┬─────────────┬─────────────┬─────────────┬─────────────╮ ╭──────╮
    X_LT     &kp SV_PRCNT  &kp SV_AT     &kp SV_HASH   &kp SV_DLLR   &kp SV_LT       X_MT     &kp SV_GT     MAC_LBRC      &kp SV_STAR   MAC_RBRC    &kp SV_CARET      X_RT
//├──────┤ ├─────────────┼─────────────┼─────────────┼─────────────┼─────────────┤ ├──────┤ ├─────────────┼─────────────┼─────────────┼─────────────┼─────────────┤ ├──────┤
    X_LM     &kp SV_SQT    &kp SV_MINUS  &kp SV_DQT    &kp SV_EQUAL  &kp SV_QMARK    X_MM     &kp EXCL      &kp SV_LPAR   &kp SV_FSLH   &kp SV_RPAR   &kp SV_COLON    X_RM
//├──────┤ ├─────────────┼─────────────┼─────────────┼─────────────┼─────────────┤ ├──────┤ ├─────────────┼─────────────┼─────────────┼─────────────┼─────────────┤ ├──────┤
    X_LB     MAC_BSLH      &kp SV_UNDER  &kp SV_TILDE  &kp SV_GRAVE  &kp SV_LBRC     X_MB     &kp SV_AMPS   &kp SV_LBKT   &kp SV_PLUS   &kp SV_RBKT   &kp SV_SEMICOLON X_RB
//├──────┤ ╰─────────────┼─────────────┴─────────────┼─────────────┼─────────────┤ ├──────┤ ├─────────────┼─────────────┼─────────────┴─────────────┴─────────────╯ ├──────┤
    X_LH                                               &to SV        &kp SV_EURO     X_MH    &mac_euro_sign &to SV_MAC                                                X_RH
//╰──────╯                                           ╰─────────────┴─────────────╯ ╰──────╯ ╰─────────────┴─────────────╯                                           ╰──────╯
)

ZMK_LAYER(sys,
//╭──────╮ ╭─────────────┬─────────────┬─────────────┬─────────────┬─────────────╮ ╭──────╮ ╭─────────────┬─────────────┬─────────────┬─────────────┬─────────────╮ ╭──────╮
    X_LT                                _BT_SEL_KEYS_                                X_MT     ___           ___           ___           ___           ___             X_RT
//├──────┤ ├─────────────┼─────────────┼─────────────┼─────────────┼─────────────┤ ├──────┤ ├─────────────┼─────────────┼─────────────┼─────────────┼─────────────┤ ├──────┤
    X_LM                                _BT_DISC_KEYS_               &bootloader     X_MM     &bootloader   ___           ___           ___           ___             X_RM
//├──────┤ ├─────────────┼─────────────┼─────────────┼─────────────┼─────────────┤ ├──────┤ ├─────────────┼─────────────┼─────────────┼─────────────┼─────────────┤ ├──────┤
    X_LB     &bt BT_CLR_ALL ___          ___           ___           &sys_reset      X_MB     &sys_reset    ___           ___           ___           ___             X_RB
//├──────┤ ╰─────────────┼─────────────┴─────────────┼─────────────┼─────────────┤ ├──────┤ ├─────────────┼─────────────┼─────────────┴───────────────────────────╯ ├──────┤
    X_LH   /* S key added for debugging purposes */    &kp S         ___             X_MH     ___           ___                                                       X_RH
//╰──────╯                                           ╰─────────────┴─────────────╯ ╰──────╯ ╰─────────────┴─────────────╯                                           ╰──────╯
)

ZMK_LAYER(uc_both,
//╭──────╮ ╭─────────────┬─────────────┬─────────────┬─────────────┬─────────────╮ ╭──────╮ ╭─────────────┬─────────────┬─────────────┬─────────────┬─────────────╮ ╭──────╮
    X_LT     &lin_sv_ao    &lin_sv_oe    &lin_sv_ae    &lin_euro_sign  ___           X_MT     ___           ___           ___           ___           ___             X_RT
//├──────┤ ├─────────────┼─────────────┼─────────────┼─────────────┼─────────────┤ ├──────┤ ├─────────────┼─────────────┼─────────────┼─────────────┼─────────────┤ ├──────┤
    X_LM     ___           ___          ___            ___           ___             X_MM     ___           ___            ___          ___           ___             X_RM
//├──────┤ ├─────────────┼─────────────┼─────────────┼─────────────┼─────────────┤ ├──────┤ ├─────────────┼─────────────┼─────────────┼─────────────┼─────────────┤ ├──────┤
    X_LB     &mac_sv_ae    &mac_sv_oe    &mac_sv_ao    &mac_euro_sign  ___           X_MB     ___           ___           ___           ___           ___             X_RB
//├──────┤ ╰─────────────┼─────────────┴─────────────┼─────────────┼─────────────┤ ├──────┤ ├─────────────┼─────────────┼─────────────┴───────────────────────────╯ ├──────┤
    X_LH   /* U key added for debugging purposes */    &kp U         ___             X_MH     ___           ___                                                       X_RH
//╰──────╯                                           ╰─────────────┴─────────────╯ ╰──────╯ ╰─────────────┴─────────────╯                                           ╰──────╯
)

